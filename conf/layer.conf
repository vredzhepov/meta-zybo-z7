## conf/layer.conf
```bitbake
# We have a conf and classes directory, add to BBPATH
BBPATH .= ":${LAYERDIR}"

# We have recipes-* directories, add to BBFILES
BBFILES += "${LAYERDIR}/recipes-*/*/*.bb ${LAYERDIR}/recipes-*/*/*.bbappend"

BBFILE_COLLECTIONS += "zybo-z7"
BBFILE_PATTERN_zybo-z7 = "^${LAYERDIR}/"
BBFILE_PRIORITY_zybo-z7 = "5"

# This should only be incremented on significant changes that will
# cause compatibility issues with other layers
LAYERVERSION_zybo-z7 = "1"

LAYERDEPENDS_zybo-z7 = "core"

LAYERSERIES_COMPAT_zybo-z7 = "zeus"
```
